//================================================================
//Libraries
//================================================================

#include <stdlib.h>

#include <avr/io.h>
#include <avr/interrupt.h>
#include <avr/pgmspace.h>
#include <util/delay.h>

#include "RGB_setup.h"

//================================================================
//Font
//================================================================
const unsigned char text[] PROGMEM = {
0x00,0x00,0x00,0x00,0x00,0x00,0x00,0x00, //0/ --> 
0x00,0x00,0x00,0x00,0x00,0x00,0x00,0x00, //1/ --> 
0x00,0x00,0x00,0x00,0x00,0x00,0x00,0x00, //2/ --> 
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0xC3,0xE3,0xF3,0xDB,0xDB,0xCF,0xC7,0x00, //90/ --> Z
};



//================================================================
//Global Variables
//================================================================
static char frame_data[64];	//Frame Data buffer contains 64 Bytes which correspond to the color for each LED on the RGB Matrix. This Frame will be sent over SPI.
static char character_leds[8];	//The Character LED buffer contains the color for one row of LEDs on the RGB Matrix. These values are copied into the Frame Data buffer.

static char text_color=RED, background_color=BLACK;	//These values define what color will be filled in the Frame Data buffer. Colors are defined in Setup.h

//Messages to be displayed on the Matrix
static char message_1[]="WELCOME";
static char message_2[]="TO";
static char message_3[]="POLYTECH LILLE!";

int rgb_main (void)
{	
	char current_message=0;	//Indicates which string we should be displaying
	char change_message=1;	//Flag to notify firmware we've finished displaying the current message and we need to get the next one
	char *message='\0';		//Pointer to the string we want to display

    init_rgb(); //Boot up defaults and configure Bluetooth connection

	while(1){
		//Check to see if we need to get a new message to display
		if(change_message){
			change_message=0;	//Reset the flag
			//Grab the appropriate message
			if(current_message==0)message=&message_1[0];
			if(current_message==1)message=&message_2[0];
			if(current_message==2)message=&message_3[0];
		}
		
		//Each time through this loop, we'll send an image to the RGB backpack. The scroll index will tell put_char() the row index of character start position on the matrix
		//After running through the entirety of this loop, the current message character will have scrolled across the RGB matrix one row at a time, and the
		//next character will currently be on the matrix.
		int scroll_index;
		for(scroll_index=-1; scroll_index >=-8; scroll_index--){
			
			//Put the current character, offset by scroll_index, into the frame_data[] buffer
			putchar_frame(message, scroll_index, text_color);
			
			cbi(PORTB, CS);		//Putting the CS line low will start the communication sequence
			int LED;
			_delay_ms(1);
//#ifdef MATRIX_V24
			spi_exch(0x26);
//#endif
			for(LED=0; LED<64; LED++){	//Send 64 bytes to the RGB serial backpack. One byte is sent for each LED. The format of the byte is RRRGGGBB.
				spi_exch(frame_data[LED]);	//*See ioinit() for SPI Hardware Setup
			}
			_delay_ms(1);
			sbi(PORTB, CS);		//Setting the CS line high will terminate the communication sequence.

			_delay_ms(100);		//Pause before sending the next set of data
		}	

		//If we've reached the end of the current message, it's time to get the next one
		if(*(message+1)=='\0'){
			current_message+=1;
			if(current_message==3)current_message=0;
			change_message=1;
		}
		//If we haven't reached the end of the current message, increment to get the next character
		else message+=1;
	}

    return (0);
}


//Core functions
//==================================================
//Usage:	init_rgb();
//Purpose:	Initialize the AVR I/O, SPI Hardware and UART
//Inputs:	None
//Outputs:	None
void init_rgb(void)
{
    //1 = output, 0 = input
	//Setup the AVR I/O
	DDRB |= (1<<CS)|(1<<MOSI)|(1<<SCK);

    //SPI Bus setup
	SPCR = (1<<SPE)|(1<<MSTR)|(1<<SPR0)|(1<<SPR1);	//Enable SPI HW, Master Mode, divide clock by 
	//NOTE: By Default, CPOL and CPHA are 0. This means you should set up your SPI hardware for
	//      and active high clock; and the SPI bus should sample on the leading (rising) edge and setup data on the trailing (falling) edge.


//	cbi(PORTB, CS);		//Putting the CS line low will start the communication sequence
//	_delay_ms(1);
//	spi_exch('%');
//	spi_exch(1);
//	_delay_ms(1);
//	sbi(PORTB, CS);
}


//Usage:	returned_char=spi_exch(0xA5);
//Purpose:	Sends/Received a character on the SPI bus
//Inputs:	uint8_t output->character to be sent to the SPI bus
//Outputs:	Returns the character that was received on the SPI bus
uint8_t spi_exch(uint8_t output)
{
	SPDR = output;				//Send Output to the SPI Data Register to initialize "Send"
	while(!(SPSR & 1<<SPIF));	//Wait for SPI to finish sending
	return SPDR;				//Return the received byte
}

//Usage:	putchar_frame(current_message, -1, RED);
//Purpose:	Puts data into the Frame Data buffer to be displayed on the RGB matrix. Depending
//			on the position, part of the current character along with part of the next character
//			in the string will be displayed
//Inputs:	char *message->pointer to the current character in the string to be displayed.
//			int position->Position allows you to display the character from a given starting position.
//			(i.e. If you pass the character 'R', and the next character in the string is 'Y', and you 
//			 send position=-4, then the second half of 'R' will be displayed, followed by the first
//			 half of 'Y'.)
//			char color->Color to display the character
//
//Outputs:	None
void putchar_frame(char *message, int position, char color){
	//Loads the character in the Text Array (Located at the top of this file)
	//NOTE: Only capital letters are supported in this sample.
	int text_offset = message[0]*8;
	int text_offset_2=0;
	
	//Check to see if there is a character after the current character.
	if(message[1]!='\n')text_offset_2 = message[1]*8;

	//If a positive position is sent, we should fill (8-position) rows with the background color
	//before starting to fill the matrix with the text data.
	if(position >= 0){
		//Fill the first 'position' rows with the background color
		int row;
		for(row=0; row<position; row++){
			character_leds[row]=background_color;
		}
		//After row 'position' fill the rest of the matrix with the text data
		for(row=position; row<8; row++){
			character_leds[row]=pgm_read_byte(&(text[text_offset+(row-position)]));
		}
	}
	
	//If a negative position is sent, fill in the (position-8) rows with the current character,
	//then fill the remaining rows with the next character.
	else{
		//Fill the first 'position' rows with the second character
		int row;
		for(row=position; row <0; row++){
			if(message[1]!='\n'){
				character_leds[row+8]=pgm_read_byte(&(text[text_offset_2+(row-position)]));
			}
			else character_leds[8+row]=background_color;
		}
		//Fill the rest of the rows with the current character
		for(row=-8; row<position; row++){
			character_leds[8+row]=pgm_read_byte(&(text[text_offset+((row+8)-position)]));
		}
	}

	//Copy the Character LEDs buffer into the Frame Data buffer.
	int row;
	for(row=0; row<8; row++){
		int LED;
		for(LED=0; LED<8; LED++){			
			//Map the Character LEDs to their correct location in the Frame Data buffer
			if(character_leds[row] & (1<<abs(LED-7)))frame_data[LED*8+row]=color;
			else frame_data[LED*8+row]=background_color;
		}
	}

}
